/*
 * Copyright (c) 2020 The ZMK Contributors
 *
 * SPDX-License-Identifier: MIT
 */

#include <dt-bindings/zmk/behaviors.h>

/ {
    behaviors {
#if ZMK_BEHAVIOR_OMIT(DM)
        /omit-if-no-ref/
#endif
        // Name must be at most 8 characters long
        lang_ch: lang_ch {
            compatible = "zmk,behavior-language-choose";
            #binding-cells = <2>;
            display-name = "Language choose";
        };
    };
};

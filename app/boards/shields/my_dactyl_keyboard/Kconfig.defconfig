## app/boards/shields/my_dactyl_keyboard/Kconfig.defconfig
```kconfig
# Copyright (c) 2020 Ryan Cross
# SPDX-License-Identifier: MIT

if SHIELD_MY_DACTYL_LEFT

config ZMK_KEYBOARD_NAME
    default "Dactyl"

config ZMK_SPLIT_ROLE_CENTRAL
    default y

endif

if SHIELD_MY_DACTYL_LEFT || SHIELD_MY_DACTYL_RIGHT

config ZMK_SPLIT
    default y

endif
```

## app/boards/shields/my_dactyl_keyboard/Kconfig.shield
```kconfig
# Copyright (c) 2020 Ryan Cross
# SPDX-License-Identifier: MIT

config SHIELD_MY_DACTYL_LEFT
    def_bool $(shields_list_contains,my_dactyl_keyboard_left)

config SHIELD_MY_DACTYL_RIGHT
    def_bool $(shields_list_contains,my_dactyl_keyboard_right)
```

## app/dts/bindings/behaviors/zmk,behavior-language-choose.yaml
```yaml
# Copyright (c) 2020 The ZMK Contributors
# SPDX-License-Identifier: MIT

description: Language choose

compatible: "zmk,behavior-language-choose"

include: two_param.yaml
```

## app/dts/bindings/behaviors/zmk,behavior-language-key-press.yaml
```yaml
# Copyright (c) 2020 The ZMK Contributors
# SPDX-License-Identifier: MIT

description: Language key press

compatible: "zmk,behavior-language-key-press"

include: two_param.yaml
```

## app/west.yml
```yaml
manifest:
  remotes:
    - name: nrfconnect
      url-base: https://github.com/nrfconnect
    - name: zephyrproject-rtos
      url-base: https://github.com/zephyrproject-rtos
    - name: zmkfirmware
      url-base: https://github.com/zmkfirmware
  projects:
    # NCS 2.6.1 base required by Nordic's Zigbee/ZBOSS stack.
    - name: zephyr
      remote: nrfconnect
      repo-path: sdk-zephyr
      revision: v3.5.99-ncs1-1
      import:
        name-allowlist:
          - cmsis
          - fatfs
          - hal_nordic
          - littlefs
          - lvgl
          - nanopb
          - segger
          - tinycrypt
          - zcbor
    - name: nrf
      remote: nrfconnect
      repo-path: sdk-nrf
      path: nrf
      revision: v2.6.1
      import: false
    - name: nrfxlib
      remote: nrfconnect
      repo-path: sdk-nrfxlib
      path: nrfxlib
      revision: v2.6.1
      import: false
    - name: mbedtls
      remote: nrfconnect
      repo-path: sdk-mbedtls
      path: modules/crypto/mbedtls
      revision: v3.5.2-ncs1-1
      import: false
    - name: nanopb
      revision: 8c60555d6277a0360c876bd85d491fc4fb0cd74a
      path: modules/lib/nanopb
      remote: zmkfirmware
    - name: zmk-studio-messages
      revision: 6cb4c283e76209d59c45fbcb218800cd19e9339d
      path: modules/msgs/zmk-studio-messages
      remote: zmkfirmware
    - name: zmk-joy
      url: https://github.com/Gemoglobinvnorme/zmk-joy.git
      revision: master
      path: modules/lib/zmk-joy
    - name: zmk-zigbee
      url: git@github.com:Gemoglobinvnorme/zmk-zigbee.git
      revision: master
      path: modules/lib/zmk-zigbee
  self:
    west-commands: scripts/west-commands.yml
```
